## buildroot/defconfigs/2025.11/rk-zynq-7020_defconfig
```kconfig
BR2_arm=y
BR2_cortex_a9=y
BR2_ARM_ENABLE_NEON=y
BR2_ARM_ENABLE_VFP=y
BR2_KERNEL_HEADERS_CUSTOM_GIT=y
BR2_KERNEL_HEADERS_CUSTOM_REPO_URL="https://github.com/Xilinx/linux-xlnx.git"
BR2_KERNEL_HEADERS_CUSTOM_REPO_VERSION="xilinx-v2025.2"
BR2_PACKAGE_HOST_LINUX_HEADERS_CUSTOM_6_12=y
BR2_PACKAGE_GLIBC_UTILS=y
BR2_BINUTILS_GPROFNG=y
BR2_TOOLCHAIN_BUILDROOT_CXX=y
BR2_PACKAGE_HOST_GDB=y
BR2_PACKAGE_HOST_GDB_TUI=y
BR2_PACKAGE_HOST_GDB_PYTHON3=y
BR2_PACKAGE_HOST_GDB_SIM=y
BR2_TOOLCHAIN_BARE_METAL_BUILDROOT=y
BR2_TOOLCHAIN_BARE_METAL_BUILDROOT_ARCH="arm-none-eabi arm-none-eabihf"
BR2_TOOLCHAIN_BARE_METAL_BUILDROOT_MULTILIB=y
BR2_SYSTEM_ENABLE_NLS=y
BR2_TARGET_TZ_INFO=y
BR2_LINUX_KERNEL=y
BR2_LINUX_KERNEL_CUSTOM_GIT=y
BR2_LINUX_KERNEL_CUSTOM_REPO_URL="https://github.com/Xilinx/linux-xlnx.git"
BR2_LINUX_KERNEL_CUSTOM_REPO_VERSION="xilinx-v2025.2"
BR2_LINUX_KERNEL_CUSTOM_REPO_GIT_SUBMODULES=y
BR2_LINUX_KERNEL_DEFCONFIG="xilinx_zynq"
BR2_LINUX_KERNEL_DTS_SUPPORT=y
BR2_LINUX_KERNEL_INTREE_DTS_NAME="xilinx/rk-zynq-7020"
BR2_PACKAGE_LINUX_TOOLS_CPUPOWER=y
BR2_PACKAGE_LINUX_TOOLS_GPIO=y
BR2_PACKAGE_LINUX_TOOLS_IIO=y
BR2_PACKAGE_LINUX_TOOLS_MM=y
BR2_PACKAGE_LINUX_TOOLS_TMON=y
BR2_TARGET_ROOTFS_EXT2=y
BR2_TARGET_ROOTFS_INITRAMFS=y
BR2_TARGET_ROOTFS_JFFS2=y
BR2_PACKAGE_HOST_GENIMAGE=y
BR2_PACKAGE_HOST_MTOOLS=y
```

## buildroot/image.its
```
/dts-v1/;

/ {
    description = "Zynq-7000 FIT: zImage + DTB + initramfs(cpio)";
    #address-cells = <1>;

    images {
        kernel {
            description = "Linux zImage";
            data = /incbin/("images/zImage");
            type = "kernel";
            arch = "arm";
            os = "linux";
            compression = "none";
            load = <0x02000000>;     /* safe < 0x30000000 */
            entry = <0x02000000>;
            hash-1 {
                algo = "sha256";
            };
        };

        fdt {
            description = "Device Tree Blob";
            data = /incbin/("images/system.dtb");
            type = "flat_dt";
            arch = "arm";
            compression = "none";
            load = <0x01000000>;     /* safe < 0x30000000 */
            hash-1 {
                algo = "sha256";
            };
        };

        ramdisk {
            description = "initramfs rootfs.cpio.gz";
            data = /incbin/("images/rootfs.cpio.gz");
            type = "ramdisk";
            arch = "arm";
            os = "linux";
            compression = "gzip";
            load = <0x04000000>;     /* safe < 0x30000000 */
            hash-1 {
                algo = "sha256";
            };
        };
    };

    configurations {
        default = "initramfs root";

        conf-1 {
            description = "Boot zImage + DTB + initramfs";
            kernel = "kernel";
            fdt = "fdt";
            ramdisk = "ramdisk";

            hash-1 {
                algo = "sha256";
            };
        };
    };
};
```
